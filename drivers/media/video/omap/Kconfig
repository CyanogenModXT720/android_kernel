## drivers/media/video/omap/Kconfig
```kconfig
config VIDEO_OMAP_VIDEOOUT
	tristate "Video out driver"
	depends on VIDEO_DEV && VIDEO_V4L2 && OMAP2_DSS

config VIDEO_OMAP_VIDEOOUT_BUFPOOL
	tristate "Video out driver buffer pool"
	depends on VIDEO_OMAP_VIDEOOUT

=======
config VIDEO_OMAP_VIDEOLIB
	tristate "OMAP Video out library"
	depends on VIDEO_OMAP3_V4L2
	default VIDEO_OMAP3_V4L2

config VIDEO_OMAP_VIDEOOUT
	tristate "OMAP Video out driver"
	select VIDEOBUF_DMA_SG
	select VIDEOBUF_GEN
	depends on VIDEO_OMAP3_V4L2
	default VIDEO_OMAP3_V4L2

choice
        prompt "TV Mode"
        default NTSC_M

config NTSC_M
        bool "Use NTSC_M mode"
        help
          Select this option if you want NTSC_M mode on TV

config PAL_BDGHI
        bool "Use PAL_BDGHI mode"
        help
          Select this option if you want PAL_BDGHI mode on TV

endchoice
```

## drivers/misc/netmux_linkdriver/Kconfig
```kconfig
#
# Netmux configuration
#

menu "Motorola netmux link driver"

config NETMUX_LINKDRIVER
        tristate
        default m

endmenu
```

## drivers/sim/Kconfig
```kconfig
menuconfig SIM
	tristate "SIM support"
	help
	  Say Y here to enable SIM support.
```

## drivers/usb/belcarra_otg/Kconfig
```kconfig
# @(#) balden@seth2.belcarratech.com|otg/.Makefiles/Kconfig-mxc|20051116204956|34435
# Copyright (c) 2004 Belcarra Technologies Corp
#
#                      Copyright (c) 2006, 2007 Motorola, Inc. 
#
# Changelog:
# Date               Author           Comment
# -----------------------------------------------------------------------------
# 08/09/2006         Motorola         Initial distribution
# 10/18/2006         Motorola         Add Open Src Software language
# 12/12/2006         Motorola         Changes for Open Src compliance.
# 04/06/2007         Motorola         Changes to support new hardware.
# 10/02/2007         Motorola         Changes for Open Src compliance.
#
# This Program is distributed in the hope that it will
# be useful, but WITHOUT ANY WARRANTY;
# without even the implied warranty of
# MERCHANTIBILITY or FITNESS FOR A
# PARTICULAR PURPOSE.  See the GNU
# General Public License for more details.

# This program is free software; you can redistribute it
# and/or modify it under the terms of the GNU General
# Public License as published by the Free Software
# Foundation; either version 2 of the License, or (at
# your option) any later version.  You should have
# received a copy of the GNU General Public License
# along with this program; if not, write to the Free
# Software Foundation, Inc., 675 Mass Ave,
# Cambridge, MA 02139, USA

menu "On-The-Go and USB Peripheral Support"

    config OTG
        tristate "Support for On-The-Go and USB Peripheral Support"
	default m
        ---help---
            Configure all or part of the Belcarra OTG Stack

    config OTG_HIGH_SPEED
	bool "Enable HS USB"
	depends on OTG
	default n
	---help---
		This enables HS USB in the OTG Stack.

    config OTG_NFS
	bool "Enable NFS"
	depends on OTG
	default n
	---help---
		This enables NFS in the OTG Stack.
    comment ""

    menu "On-The-Go Support Platform Selection"
        depends on OTG 
        source "drivers/usb/belcarra_otg/hardware/Kconfig-sdp2430"

    config OTG_OMAP_MENTOR
        tristate "SDP2430 or SDP3430 OMAP Evaluation Board HS (Mentor)"
        depends on OTG 
        ---help---
        This implements On-The-Go USB Support for the OMAP SDP2430 or SDP3430 EVB
        using the Mentor High Speed port.

    if ( OTG_OMAP_MENTOR != 'n')
	config OTG_PLATFORM_OTG 
		bool 
		default n
	config OTG_PLATFORM_USB 
		bool 
		default n
	config OTG_PLATFORM_USBD 
		bool 
		default y
	config OTG_HIGH_SPEED
		bool
		default y
    endif
    endmenu

    source "drivers/usb/belcarra_otg/Kconfig-otg"

    menu "Targeted Peripherals List (USB Peripheral Function Drivers)"
        depends on OTG_PLATFORM_OTG || OTG_PLATFORM_USBD
        #---help---
        #A list of USB peripheral types that this device
        #can emulate when it is acting as a peripheral.
        source "drivers/usb/belcarra_otg/functions/generic/Kconfig"
        source "drivers/usb/belcarra_otg/functions/acm/Kconfig"
        source "drivers/usb/belcarra_otg/functions/msc/Kconfig"
        source "drivers/usb/belcarra_otg/functions/network/Kconfig"
        source "drivers/usb/belcarra_otg/functions/mtp/Kconfig"
        source "drivers/usb/belcarra_otg/functions/android_adb/Kconfig"
        source "drivers/usb/belcarra_otg/functions/mouse/Kconfig"
    endmenu


endmenu
```

## drivers/usb/belcarra_otg/functions/android_adb/Kconfig
```kconfig
# 
# Copyright (c) 2006 Motorola, Inc, All Rights Reserved.
#
# This program is licensed under a BSD license with the following terms:
# 
# Redistribution and use in source and binary forms, with or without modification,
# are permitted provided that the following conditions are met:
#
#   *  Redistributions of source code must retain the above copyright notice,
#      this list of conditions and the following disclaimer.
#   *  Redistributions in binary form must reproduce the above copyright notice,
#      this list of conditions and the following disclaimer in the documentation
#      and/or other materials provided with the distribution.
#   *  Neither the name of Motorola nor the names of its contributors may
#      be used to endorse or promote products derived from this software without
#      specific prior written permission.
# 
# 
# THIS SOFTWARE IS PROVIDED BY THE COPYRIGHT HOLDERS AND CONTRIBUTORS "AS IS" AND
# ANY EXPRESS OR IMPLIED WARRANTIES, INCLUDING, BUT NOT LIMITED TO, THE IMPLIED
# WARRANTIES OF MERCHANTABILITY AND FITNESS FOR A PARTICULAR PURPOSE ARE DISCLAIMED.
# IN NO EVENT SHALL THE COPYRIGHT OWNER OR CONTRIBUTORS BE LIABLE FOR ANY DIRECT,
# INDIRECT, INCIDENTAL, SPECIAL, EXEMPLARY, OR CONSEQUENTIAL DAMAGES (INCLUDING,
# BUT NOT LIMITED TO, PROCUREMENT OF SUBSTITUTE GOODS OR SERVICES; LOSS OF USE, DATA,
# OR PROFITS; OR BUSINESS INTERRUPTION) HOWEVER CAUSED AND ON ANY THEORY OF LIABILITY,
# WHETHER IN CONTRACT, STRICT LIABILITY, OR TORT (INCLUDING NEGLIGENCE OR OTHERWISE)
# ARISING IN ANY WAY OUT OF THE USE OF THIS SOFTWARE, EVEN IF ADVISED OF THE
# POSSIBILITY OF SUCH DAMAGE.
# 
# Changelog:
# Date               Author           Comment
# -----------------------------------------------------------------------------
# 03/28/2006       Motorola         Initial Creation
#
# 
# ADB Kconfig
#

menu "OTG ANDROID ADB Function"

config OTG_ANDROID_ADB
	tristate "ANDROID ADB Function"
	depends on OTG

menu "OTG ANDROID_ADB function options"
	depends on OTG && OTG_ANDROID_ADB

config OTG_ANDROID_ADB_VENDORID
        hex "VendorID (hex value)"
	depends on OTG_ANDROID_ADB && OTG
        default "0x0bb4"

config OTG_ANDROID_ADB_PRODUCTID
	depends on OTG_ANDROID_ADB && OTG
        hex "ProductID (hex value)"
        default "0xdeed"

config OTG_ANDROID_ADB_BCDDEVICE
	depends on OTG_ANDROID_ADB && OTG
        hex "bcdDevice (binary-coded decimal)"
        default "0x0200"

config OTG_ANDROID_ADB_MANUFACTURER
	depends on OTG_ANDROID_ADB && OTG
        string "iManufacturer (string)"
        default "Motorola Inc."

config OTG_ANDROID_ADB_PRODUCT_NAME
	depends on OTG_ANDROID_ADB && OTG
        string "iProduct (string)"
        default "Motorola Phone"

config OTG_ANDROID_ADB_DESC
	depends on OTG_ANDROID_ADB && OTG
        string "iConfiguration (string)"
        default "ADB Cfg"

config OTG_ANDROID_ADB_HOTPLUG
	depends on OTG_ANDROID_ADB && OTG
        bool "start ANDROID ADB hotplug"
        default TRUE

endmenu
endmenu
```
