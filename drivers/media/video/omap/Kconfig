## mm/Kconfig
```kconfig
config SELECT_MEMORY_MODEL
	def_bool y
	depends on EXPERIMENTAL || ARCH_SELECT_MEMORY_MODEL

choice
	prompt "Memory model"
	depends on SELECT_MEMORY_MODEL
	default DISCONTIGMEM_MANUAL if ARCH_DISCONTIGMEM_DEFAULT
	default SPARSEMEM_MANUAL if ARCH_SPARSEMEM_DEFAULT
	default FLATMEM_MANUAL

config FLATMEM_MANUAL
	bool "Flat Memory"
	depends on !(ARCH_DISCONTIGMEM_ENABLE || ARCH_SPARSEMEM_ENABLE) || ARCH_FLATMEM_ENABLE
	help
	  This option allows you to change some of the ways that
	  Linux manages its memory internally.  Most users will
	  only have one option here: FLATMEM.  This is normal
	  and a correct option.

	  Some users of more advanced features like NUMA and
	  memory hotplug may have different options here.
	  DISCONTIGMEM is an more mature, better tested system,
	  but is incompatible with memory hotplug and may suffer
	  decreased performance over SPARSEMEM.  If unsure between
	  "Sparse Memory" and "Discontiguous Memory", choose
	  "Discontiguous Memory".

	  If unsure, choose this option (Flat Memory) over any other.

config DISCONTIGMEM_MANUAL
	bool "Discontiguous Memory"
	depends on ARCH_DISCONTIGMEM_ENABLE
	help
	  This option provides enhanced support for discontiguous
	  memory systems, over FLATMEM.  These systems have holes
	  in their physical address spaces, and this option provides
	  more efficient handling of these holes.  However, the vast
	  majority of hardware has quite flat address spaces, and
	  can have degraded performance from the extra overhead that
	  this option imposes.

	  Many NUMA configurations will have this as the only option.

	  If unsure, choose "Flat Memory" over this option.

config SPARSEMEM_MANUAL
	bool "Sparse Memory"
	depends on ARCH_SPARSEMEM_ENABLE
	help
	  This will be the only option for some systems, including
	  memory hotplug systems.  This is normal.

	  For many other systems, this will be an alternative to
	  "Discontiguous Memory".  This option provides some potential
	  performance benefits, along with decreased code complexity,
	  but it is newer, and more experimental.

	  If unsure, choose "Discontiguous Memory" or "Flat Memory"
	  over this option.

endchoice

config DISCONTIGMEM
	def_bool y
	depends on (!SELECT_MEMORY_MODEL && ARCH_DISCONTIGMEM_ENABLE) || DISCONTIGMEM_MANUAL

config SPARSEMEM
	def_bool y
	depends on SPARSEMEM_MANUAL

config FLATMEM
	def_bool y
	depends on (!DISCONTIGMEM && !SPARSEMEM) || FLATMEM_MANUAL

config FLAT_NODE_MEM_MAP
	def_bool y
	depends on !SPARSEMEM

#
# Both the NUMA code and DISCONTIGMEM use arrays of pg_data_t's
# to represent different areas of memory.  This variable allows
# those dependencies to exist individually.
#
config NEED_MULTIPLE_NODES
	def_bool y
	depends on DISCONTIGMEM || NUMA

config HAVE_MEMORY_PRESENT
	def_bool y
	depends on ARCH_HAVE_MEMORY_PRESENT || SPARSEMEM

#
# SPARSEMEM_EXTREME (which is the default) does some bootmem
# allocations when memory_present() is called.  If this cannot
# be done on your architecture, select this option.  However,
# statically allocating the mem_section[] array can potentially
# consume vast quantities of .bss, so be careful.
#
# This option will also potentially produce smaller runtime code
# with gcc 3.4 and later.
#
config SPARSEMEM_STATIC
	bool

#
# Architecture platforms which require a two level mem_section in SPARSEMEM
# must select this option. This is usually for architecture platforms with
# an extremely sparse physical address space.
#
config SPARSEMEM_EXTREME
	def_bool y
	depends on SPARSEMEM && !SPARSEMEM_STATIC

config SPARSEMEM_VMEMMAP_ENABLE
	bool

config SPARSEMEM_VMEMMAP
	bool "Sparse Memory virtual memmap"
	depends on SPARSEMEM && SPARSEMEM_VMEMMAP_ENABLE
	default y
	help
	 SPARSEMEM_VMEMMAP uses a virtually mapped memmap to optimise
	 pfn_to_page and page_to_pfn operations.  This is the most
	 efficient option when sufficient kernel resources are available.

# eventually, we can have this option just 'select SPARSEMEM'
config MEMORY_HOTPLUG
	bool "Allow for memory hot-add"
	depends on SPARSEMEM || X86_64_ACPI_NUMA
	depends on HOTPLUG && !HIBERNATION && ARCH_ENABLE_MEMORY_HOTPLUG
	depends on (IA64 || X86 || PPC64 || SUPERH || S390)

comment "Memory hotplug is currently incompatible with Software Suspend"
	depends on SPARSEMEM && HOTPLUG && HIBERNATION

config MEMORY_HOTPLUG_SPARSE
	def_bool y
	depends on SPARSEMEM && MEMORY_HOTPLUG

config MEMORY_HOTREMOVE
	bool "Allow for memory hot remove"
	depends on MEMORY_HOTPLUG && ARCH_ENABLE_MEMORY_HOTREMOVE
	depends on MIGRATION

#
# If we have space for more page flags then we can enable additional
# optimizations and functionality.
#
# Regular Sparsemem takes page flag bits for the sectionid if it does not
# use a virtual memmap. Disable extended page flags for 32 bit platforms
# that require the use of a sectionid in the page flags.
#
config PAGEFLAGS_EXTENDED
	def_bool y
	depends on 64BIT || SPARSEMEM_VMEMMAP || !NUMA || !SPARSEMEM

# Heavily threaded applications may benefit from splitting the mm-wide
# page_table_lock, so that faults on different parts of the user address
# space can be handled with less contention: split it at this NR_CPUS.
# Default to 4 for wider testing, though 8 might be more appropriate.
# ARM's adjust_pte (unused if VIPT) depends on mm-wide page_table_lock.
# PA-RISC 7xxx's spinlock_t would enlarge struct page from 32 to 44 bytes.
#
config SPLIT_PTLOCK_CPUS
	int
	default "4096" if ARM && !CPU_CACHE_VIPT
	default "4096" if PARISC && !PA20
	default "4"

#
# support for page migration
#
config MIGRATION
	bool "Page migration"
	def_bool y
	depends on NUMA || ARCH_ENABLE_MEMORY_HOTREMOVE
	help
	  Allows the migration of the physical location of pages of processes
	  while the virtual addresses are not changed. This is useful for
	  example on NUMA systems to put pages nearer to the processors accessing
	  the page.

config PHYS_ADDR_T_64BIT
	def_bool 64BIT || ARCH_PHYS_ADDR_T_64BIT

config ZONE_DMA_FLAG
	int
	default "0" if !ZONE_DMA
	default "1"

config BOUNCE
	def_bool y
	depends on BLOCK && MMU && (ZONE_DMA || HIGHMEM)

config NR_QUICK
	int
	depends on QUICKLIST
	default "2" if SUPERH || AVR32
	default "1"

config VIRT_TO_BUS
	def_bool y
	depends on !ARCH_NO_VIRT_TO_BUS

config UNEVICTABLE_LRU
	bool "Add LRU list to track non-evictable pages"
	default y
	depends on MMU
	help
	  Keeps unevictable pages off of the active and inactive pageout
	  lists, so kswapd will not waste CPU time or have its balancing
	  algorithms thrown off by scanning these pages.  Selecting this
	  will use one page flag and increase the code size a little,
	  say Y unless you know what you are doing.

config MMU_NOTIFIER
	bool

config DEBUG_MEMLEAK_DYNAMIC_NR
	bool "Dynamic maximum number of reported leaks"
	default n
	depends on DEBUG_MEMLEAK
	help
	  This option sets the maximum number of leaks reported. If
	  this number is too big and there are leaks to be reported,
	  reading the /sys/kernel/debug/memleak file could lead to
	  some soft-locks.

config DEBUG_MEMLEAK_HASH_BITS
	int "Pointer hash bits"
	default 16
	depends on DEBUG_MEMLEAK
	help
	  This option sets the number of bits used for the pointer
	  hash table. Higher values give better memory scanning
	  performance but also lead to bigger RAM usage. The size of
	  the allocated hash table is (sizeof(void*) * 2^hash_bits).

	  The minimum recommended value is 16. A maximum value of
	  around 20 should be sufficient.

config DEBUG_MEMLEAK_TRACE_LENGTH
	int "Stack trace length"
	default 4
	depends on DEBUG_MEMLEAK && FRAME_POINTER
	help
	  This option sets the length of the stack trace for the
	  allocated objects tracked by kmemleak.

config DEBUG_MEMLEAK_PREINIT_OBJECTS
	int "Pre-init actions buffer size"
	default 512
	depends on DEBUG_MEMLEAK
	help
	  This is the buffer for storing the memory allocation/freeing
	  calls before kmemleak is fully initialized. Each element in
	  the buffer takes 24 bytes on a 32 bit architecture. This
	  buffer will be freed once the system initialization is
	  completed.

config DEBUG_MEMLEAK_SECONDARY_ALIASES
	bool "Create secondary level pointer aliases"
	default y
	depends on DEBUG_MEMLEAK
	help
	  This option creates aliases for container_of(container_of(member))
	  access to objects. Disabling this option reduces the chances of
	  false negatives but it can slightly increase the number of false
	  positives.

config DEBUG_MEMLEAK_TASK_STACKS
	bool "Scan task kernel stacks"
	default y
	depends on DEBUG_MEMLEAK
	help
	  This option enables the scanning of the task kernel
	  stacks. This option can introduce false negatives because of
	  the randomness of stacks content.

	  If unsure, say Y.

config DEBUG_MEMLEAK_ORPHAN_FREEING
	bool "Notify when freeing orphan objects"
	default n
	depends on DEBUG_MEMLEAK
	help
	  This option enables the notification when objects
	  considered leaks are freed. The stack dump and the object
	  information displayed allow an easier identification of
	  false positives. Use this mainly for debugging kmemleak.

	  If unsure, say N.

config DEBUG_MEMLEAK_REPORT_THLD
	int "Unreferenced reporting threshold"
	default 1
	depends on DEBUG_MEMLEAK
	help
	  This option sets the number of times an object needs to be
	  detected as unreferenced before being reported as a memory
	  leak. A value of 0 means that the object will be reported
	  the first time it is found as unreferenced. Other positive
	  values mean that the object needs to be found as
	  unreferenced a specified number of times prior to being
	  reported.

	  This is useful to avoid the reporting of transient false
	  positives where the pointers might be held in CPU registers,
	  especially on SMP systems, or on the stack when the stack
	  scanning option is disabled.

config DEBUG_KEEP_INIT
	bool "Do not free the __init code/data"
	default n
	depends on DEBUG_MEMLEAK
	help
	  This option moves the __init code/data out of the
	  .init.text/.init.data sections. It is useful for identifying
	  memory leaks happening during the kernel or modules
	  initialization.

	  If unsure, say N.

config DEBUG_MEMLEAK_TEST
	tristate "Test the kernel memory leak detector"
	default n
	depends on DEBUG_MEMLEAK
	help
	  Say Y or M here to build the test harness for the kernel
	  memory leak detector. At the moment, this option enables a
	  module that explicitly leaks memory.

	  If unsure, say N.
```
